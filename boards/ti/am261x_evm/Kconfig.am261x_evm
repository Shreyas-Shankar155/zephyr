## boards/ti/am261x_evm/Kconfig.am261x_evm
```kconfig
# Texas Instruments Sitara AM243x EVM
#
# Copyright (c) 2025 Texas Instruments Incorporated
#
# SPDX-License-Identifier: Apache-2.0

config BOARD_AM261X_EVM
	select SOC_AM261X_R5F0_0 if BOARD_AM261X_EVM_AM261X_R5F0_0
```

## boards/ti/am261x_evm/board.yml
```yaml
board:
  name: am261x_evm
  full_name: TI AM261x-EVM
  vendor: ti
  socs:
  - name: am261x
```

## samples/drivers/display/boards/esp32_devkitc_procpu.conf
```kconfig
#
# SPDX-License-Identifier: Apache-2.0
#

CONFIG_I2C=y
CONFIG_DISPLAY=y
CONFIG_SSD1306=y
```

## soc/ti/k3/am261x/Kconfig
```kconfig
# Copyright (c) 2023 Enphase Energy
# SPDX-License-Identifier: Apache-2.0

config SOC_SERIES_AM261X_R5
	select ARM
	select CPU_CORTEX_R5
	# select VIM
	select UART_NS16550_ACCESS_WORD_ONLY if UART_NS16550
	select SOC_EARLY_INIT_HOOK  #purpose of this unknown

config SOC_PART_NUMBER
	default "AM261x" if SOC_AM261X_R5F0_0
```

## soc/ti/k3/am261x/Kconfig.soc
```kconfig
# Copyright (c) 2023 Enphase Energy
# SPDX-License-Identifier: Apache-2.0


# Refer to AM6x before committing changes in PR
config SOC_SERIES_AM261X
	bool
	select SOC_FAMILY_TI_K3

config SOC_SERIES_AM261X_R5
	bool
	select SOC_SERIES_AM261X
	help	
		Enable support for AM261X R5 Series

config SOC_AM261X_R5F0_0
	bool
	select SOC_SERIES_AM261X_R5

config SOC_SERIES
	# default "am6x" if SOC_SERIES_AM6X
	default "am261x" if SOC_SERIES_AM261X

config SOC
	# default "am6232" if SOC_AM6232_M4 || SOC_AM6232_A53
	# default "am6234" if SOC_AM6234_M4 || SOC_AM6234_A53
	# default "am6442" if SOC_AM6442_M4
	# default "j721e" if SOC_J721E_MAIN_R5F0_0
	# default "j722s" if SOC_J722S_MAIN_R5F0_0 || SOC_J722S_MCU_R5F0_0
	#SOC specific definitions here 
	default "am261x" if SOC_AM261X_R5F0_0  


# Hacks that need to be deleted later

config SYS_CLOCK_HW_CYCLES_PER_SEC
	default 400000000 if SOC_AM261X_R5F0_0

#check default value, configure VIM instead if possible
config NUM_IRQS
	default 64 if SOC_AM261X_R5F0_0  
```
